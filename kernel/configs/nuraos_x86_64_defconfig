## kernel/configs/nuraos_x86_64_defconfig
```kconfig
# NuraOS x86-64 kernel config fragment
# Applied on top of tinyconfig via scripts/kernel-config.sh.
# Only options that differ from tinyconfig (or must be explicitly set) appear here.
#
# HARDENING NOTE: All hardening features stripped for QEMU TCG CI compatibility.
# The kernel was panicking silently before parse_early_param() ran (0 serial
# bytes, panic=5 exit timing). Removed: STACKPROTECTOR_STRONG, BUG_ON_DATA_CORRUPTION,
# INIT_ON_ALLOC_DEFAULT_ON, FORTIFY_SOURCE, SLAB_FREELIST_HARDENED, HARDENED_USERCOPY,
# SHUFFLE_PAGE_ALLOCATOR, RETPOLINE/CPU_IBPB_ENTRY, ACPI, CPU_FREQ, LSM/Landlock,
# NETFILTER. Re-enable incrementally once the basic boot is verified green.

# ----- Architecture basics -----
CONFIG_64BIT=y
CONFIG_X86_64=y
CONFIG_SMP=y
CONFIG_NR_CPUS=4

# ----- Binary format -----
CONFIG_BINFMT_ELF=y
CONFIG_BINFMT_SCRIPT=y

# ----- Virtual filesystems -----
CONFIG_PROC_FS=y
CONFIG_PROC_SYSCTL=y
CONFIG_SYSFS=y
CONFIG_TMPFS=y
CONFIG_DEVTMPFS=y
CONFIG_DEVTMPFS_MOUNT=y

# ----- Persistent storage -----
CONFIG_EXT4_FS=y
CONFIG_EXT4_USE_FOR_EXT2=y

# ----- Initramfs / initrd -----
CONFIG_BLK_DEV_INITRD=y
CONFIG_INITRAMFS_SOURCE=""
CONFIG_RD_GZIP=y
CONFIG_RD_XZ=y

# ----- Serial console -----
CONFIG_TTY=y
CONFIG_SERIAL_8250=y
CONFIG_SERIAL_8250_CONSOLE=y
CONFIG_SERIAL_EARLYCON=y
CONFIG_VT=n

# ----- Printk / early console -----
CONFIG_PRINTK=y
CONFIG_EARLY_PRINTK=y

# ----- virtio -----
CONFIG_VIRTIO=y
CONFIG_VIRTIO_PCI=y
CONFIG_VIRTIO_BLK=y
CONFIG_VIRTIO_NET=y
CONFIG_HW_RANDOM=y
CONFIG_HW_RANDOM_VIRTIO=y

# ----- Networking (basic only) -----
CONFIG_NET=y
CONFIG_INET=y
CONFIG_PACKET=y
CONFIG_UNIX=y
CONFIG_IPV6=n

# ----- Block layer -----
CONFIG_BLOCK=y
CONFIG_BLK_DEV=y

# ----- PCI -----
CONFIG_PCI=y
CONFIG_PCI_MSI=y

# ----- Clock / timer -----
CONFIG_HZ_250=y
CONFIG_POSIX_TIMERS=y

# ----- Modules: disabled -----
CONFIG_MODULES=n

# ----- KASLR and stack protection: disabled for QEMU TCG -----
# These interact with QEMU TCG and cause a silent panic before parse_early_param().
CONFIG_RANDOMIZE_BASE=n
CONFIG_RANDOMIZE_MEMORY=n
CONFIG_STACKPROTECTOR=n

# ----- Namespace isolation -----
CONFIG_NAMESPACES=y
CONFIG_IPC_NS=y
CONFIG_UTS_NS=y
CONFIG_PID_NS=y
CONFIG_NET_NS=y
CONFIG_USER_NS=n

# ----- Cgroup v2 (unified hierarchy) -----
CONFIG_CGROUPS=y
CONFIG_CGROUP_SCHED=y
CONFIG_FAIR_GROUP_SCHED=y
CONFIG_CFS_BANDWIDTH=y
CONFIG_CGROUP_CPUACCT=y
CONFIG_CGROUP_FREEZER=y
CONFIG_MEMCG=y
CONFIG_MEMCG_SWAP=n
CONFIG_BLKCG=y
CONFIG_CGROUP_PIDS=y

# ----- Seccomp (needed by gateway) -----
CONFIG_SECCOMP=y
CONFIG_SECCOMP_FILTER=y

# ----- Misc needed -----
CONFIG_MULTIUSER=y
CONFIG_SHMEM=y
CONFIG_ANON_INODES=y
CONFIG_EPOLL=y
CONFIG_SIGNALFD=y
CONFIG_TIMERFD=y
CONFIG_EVENTFD=y
CONFIG_AIO=y
CONFIG_FILE_LOCKING=y

# ----- Debug: off -----
CONFIG_DEBUG_KERNEL=n
CONFIG_DEBUG_INFO=n
CONFIG_MAGIC_SYSRQ=n
CONFIG_KALLSYMS=n
CONFIG_FTRACE=n
```
